## board/mixtile/blade3-rk3588/Kconfig
```kconfig
if TARGET_BLADE3_RK3588

config SYS_BOARD
	default "blade3-rk3588"

config SYS_VENDOR
	default "mixtile"

config SYS_CONFIG_NAME
	default "blade3-rk3588"

config BOARD_SPECIFIC_OPTIONS # dummy
	def_bool y

endif
```

## configs/blade3-rk3588_defconfig
```kconfig
CONFIG_ARM=y
CONFIG_ARCH_ROCKCHIP=y
CONFIG_SPL_LIBCOMMON_SUPPORT=y
CONFIG_SPL_LIBGENERIC_SUPPORT=y
CONFIG_ROCKCHIP_RK3588=y
CONFIG_USING_KERNEL_DTB_V2=y
CONFIG_TARGET_EVB_RK3588=y
CONFIG_SPL_SPI_FLASH_SUPPORT=y
CONFIG_DEFAULT_DEVICE_TREE="rk3588-mixtile-blade3"
CONFIG_DEBUG_UART=y
CONFIG_FIT=y
CONFIG_SPL_LOAD_FIT=y
# CONFIG_SPL_SYS_DCACHE_OFF is not set
CONFIG_BOOTDELAY=3
# CONFIG_DISPLAY_CPUINFO is not set
# CONFIG_SPL_RAW_IMAGE_SUPPORT is not set
# CONFIG_SPL_LEGACY_IMAGE_SUPPORT is not set
CONFIG_SPL_ATF=y
CONFIG_CMD_BOOTZ=y
# CONFIG_CMD_ELF is not set
# CONFIG_CMD_IMI is not set
# CONFIG_CMD_IMLS is not set
# CONFIG_CMD_XIMG is not set
# CONFIG_CMD_LZMADEC is not set
# CONFIG_CMD_UNZIP is not set
# CONFIG_CMD_FLASH is not set
# CONFIG_CMD_FPGA is not set
CONFIG_CMD_GPT=y
# CONFIG_CMD_LOADB is not set
# CONFIG_CMD_LOADS is not set
CONFIG_CMD_MMC=y
CONFIG_CMD_PCI=y
CONFIG_CMD_USB=y
# CONFIG_CMD_ITEST is not set
# CONFIG_CMD_SETEXPR is not set
# CONFIG_CMD_MISC is not set
# CONFIG_SPL_DOS_PARTITION is not set
# CONFIG_ISO_PARTITION is not set
CONFIG_EFI_PARTITION_ENTRIES_NUMBERS=64
CONFIG_SPL_OF_CONTROL=y
CONFIG_OF_LIVE=y
CONFIG_OF_SPL_REMOVE_PROPS="clock-names interrupt-parent assigned-clocks assigned-clock-rates assigned-clock-parents"
# CONFIG_NET_TFTP_VARS is not set
CONFIG_SPL_REGMAP=y
CONFIG_SPL_SYSCON=y
# CONFIG_SARADC_ROCKCHIP is not set
CONFIG_SPL_CLK=y
CONFIG_ROCKCHIP_GPIO=y
CONFIG_SYS_I2C_ROCKCHIP=y
CONFIG_MISC=y
CONFIG_MMC_DW=y
CONFIG_MMC_DW_ROCKCHIP=y
CONFIG_MMC_SDHCI=y
CONFIG_MMC_SDHCI_SDMA=y
CONFIG_MMC_SDHCI_ROCKCHIP=y
CONFIG_PHY_REALTEK=y
CONFIG_DWC_ETH_QOS=y
CONFIG_NVME=y
CONFIG_PCI=y
CONFIG_PCIE_DW_ROCKCHIP=y
CONFIG_PHY_ROCKCHIP_NANENG_COMBOPHY=y
CONFIG_PHY_ROCKCHIP_TYPEC=y
CONFIG_SPL_PINCTRL=y
CONFIG_REGULATOR_PWM=y
CONFIG_PWM_ROCKCHIP=y
CONFIG_SPL_RAM=y
CONFIG_BAUDRATE=1500000
CONFIG_DEBUG_UART_BASE=0xFEB50000
CONFIG_DEBUG_UART_CLOCK=24000000
CONFIG_DEBUG_UART_SHIFT=2
CONFIG_ROCKCHIP_SFC=y
CONFIG_SYSRESET=y
CONFIG_USB=y
CONFIG_USB_XHCI_HCD=y
CONFIG_USB_EHCI_HCD=y
CONFIG_USB_EHCI_GENERIC=y
CONFIG_USB_OHCI_HCD=y
CONFIG_USB_OHCI_GENERIC=y
CONFIG_USB_DWC3=y
CONFIG_USB_DWC3_GENERIC=y
CONFIG_USB_GADGET=y
CONFIG_USB_GADGET_DOWNLOAD=y
CONFIG_DRM_ROCKCHIP_DW_HDMI_QP=y
CONFIG_DRM_ROCKCHIP_DW_MIPI_DSI2=y
CONFIG_ERRNO_STR=y
# CONFIG_EFI_LOADER is not set

# Config I added
CONFIG_SYS_LOAD_ADDR=0xc00800
CONFIG_TEXT_BASE=0x00a00000
CONFIG_SPL_BSS_MAX_SIZE=0x4000
CONFIG_HAS_CUSTOM_SYS_INIT_SP_ADDR=y
CONFIG_CUSTOM_SYS_INIT_SP_ADDR=0xc00000
CONFIG_SPL_ROCKCHIP_COMMON_BOARD=y
# CONFIG_SPL_BOARD_INIT=y
# CONFIG_FIT_IMAGE_POST_PROCESS=y
# CONFIG_SPL_FIT_IMAGE_POST_PROCESS=y
CONFIG_CMD_GPIO=y
CONFIG_CMD_REGULATOR=y
CONFIG_COUNTER_FREQUENCY=24000000
CONFIG_DEFAULT_DEVICE_TREE="rk3588-mixtile-blade3"
CONFIG_DEFAULT_FDT_FILE="rockchip/rk3588-mixtile-blade3.dtb"
CONFIG_FIT_VERBOSE=y
CONFIG_LEGACY_IMAGE_FORMAT=y
CONFIG_NR_DRAM_BANKS=2
CONFIG_OF_BOARD_SETUP=y
CONFIG_PHY_ROCKCHIP_NANENG_COMBOPHY=y
CONFIG_RTL8169=y
CONFIG_SKIP_LOWLEVEL_INIT=y
CONFIG_SPL_BSS_START_ADDR=0x4000000
CONFIG_SPL_FIT_SIGNATURE=y
CONFIG_SPL_HAS_BSS_LINKER_SECTION=y
CONFIG_SPL_MAX_SIZE=0x40000
CONFIG_SPL_PAD_TO=0x7f8000
CONFIG_SPL_SERIAL=y
CONFIG_SPL_STACK=0x400000
CONFIG_SPL_STACK_R=y
CONFIG_SPL_STACK_R_ADDR=0x600000
CONFIG_SUPPORT_EMMC_RPMB=y
CONFIG_SYS_NS16550_MEM32=y
CONFIG_TARGET_BLADE3_RK3588=y
# CONFIG_USB_FUNCTION_FASTBOOT is not set

# TODO verify if needed
CONFIG_NVME=y
CONFIG_SYS_HAS_NONCACHED_MEMORY=y

# Personal
CONFIG_BOOTSTD=y
CONFIG_BOOTSTD_FULL=y
CONFIG_BOOTSTD_DEFAULTS=y
CONFIG_PARTITION_TYPE_GUID=y
CONFIG_ENV_IS_IN_FAT=y
```
